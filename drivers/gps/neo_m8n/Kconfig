## drivers/gps/neo_m8n/Kconfig
```kconfig
# SPDX-License-Identifier: GPL-2.0-only
#
# Kconfig for u-blox NEO-M8N GPS/GNSS Driver
#

config GNSS_UBLOX_NEO
	tristate "u-blox NEO-M8N/M9N GPS/GNSS Driver"
	depends on SERIAL_DEV_BUS
	select GNSS
	help
	  Say Y here if you want to support u-blox NEO-M8 series
	  and NEO-M9 series GPS/GNSS modules.

	  This driver supports:
	    - NEO-M8N (GPS, GLONASS, Galileo, BeiDou)
	    - NEO-M8M (GPS, GLONASS)
	    - NEO-M8Q (GPS, GLONASS, Galileo, BeiDou)
	    - NEO-M9N (GPS, GLONASS, Galileo, BeiDou)

	  To compile this driver as a module, choose M here: the
	  module will be called ublox_neo_m8n.

	  If unsure, say N.

if GNSS_UBLOX_NEO

config GNSS_UBLOX_NEO_UBX
	bool "UBX protocol support"
	depends on GNSS_UBLOX_NEO
	default y
	help
	  Say Y here to enable u-blox UBX binary protocol support
	  in addition to NMEA. UBX protocol provides more detailed
	  positioning information and device configuration.

	  If unsure, say Y.

config GNSS_UBLOX_NEO_PPS
	bool "PPS (Pulse Per Second) support"
	depends on GNSS_UBLOX_NEO
	depends on PPS
	help
	  Say Y here to enable PPS (Pulse Per Second) support for
	  precise time synchronization. This requires the TIMEPULSE
	  pin to be connected to a GPIO with interrupt capability.

config GNSS_UBLOX_NEO_POWER_MANAGEMENT
	bool "Power management support"
	depends on GNSS_UBLOX_NEO
	default y
	help
	  Say Y here to enable power management for the GPS module.
	  This allows putting the module into low-power modes when
	  not actively acquiring position.

config GNSS_UBLOX_NEO_DEBUG
	bool "Enable debug output"
	depends on GNSS_UBLOX_NEO
	help
	  Say Y here to enable debug output including UBX message
	  parsing and NMEA sentence logging.

	  If unsure, say N.

endif # GNSS_UBLOX_NEO
```

## drivers/peripheral/spi/Kconfig
```kconfig
# SPDX-License-Identifier: GPL-2.0-only
#
# Kconfig for Custom SPI Controller Driver
#

config SPI_CUSTOM
	tristate "Custom SPI Controller Driver"
	depends on HAS_IOMEM
	depends on SPI_MASTER
	help
	  This driver supports the Custom SPI controller as a master.
	  It provides full SPI functionality including multiple chip
	  selects, configurable clock rates, and all SPI modes.

	  To compile this driver as a module, choose M here: the
	  module will be called custom_spi.

	  If unsure, say N.

if SPI_CUSTOM

config SPI_CUSTOM_DMA
	bool "DMA support for Custom SPI"
	depends on SPI_CUSTOM
	depends on DMADEVICES
	select DMA_ENGINE
	help
	  Say Y here to enable DMA support for the Custom SPI controller.
	  DMA can significantly improve performance for large transfers
	  by offloading data movement to the DMA controller.

	  When DMA is enabled, small transfers (smaller than FIFO depth)
	  will still use PIO mode for efficiency.

	  If unsure, say Y.

config SPI_CUSTOM_DMA_MIN_BYTES
	int "Minimum bytes for DMA transfer"
	depends on SPI_CUSTOM_DMA
	default 64
	range 16 4096
	help
	  Set the minimum transfer size to use DMA. Transfers smaller
	  than this will use PIO (programmed I/O) mode instead.

	  The default is 64 bytes (FIFO depth). Setting this higher
	  reduces DMA overhead for medium-sized transfers.

config SPI_CUSTOM_DEBUG
	bool "Enable debug output"
	depends on SPI_CUSTOM
	help
	  Say Y here to enable verbose debug output for the Custom SPI
	  driver. This will print detailed information about transfers,
	  DMA operations, and register accesses.

	  This is useful for debugging but will impact performance.

	  If unsure, say N.

config SPI_CUSTOM_MAX_CHIPSELECT
	int "Maximum number of chip selects"
	depends on SPI_CUSTOM
	default 4
	range 1 16
	help
	  Set the maximum number of chip selects supported by each
	  Custom SPI controller instance.

endif # SPI_CUSTOM
```

## drivers/peripheral/uart/Kconfig
```kconfig
# SPDX-License-Identifier: GPL-2.0-only
#
# Kconfig for Custom UART Driver
#

config SERIAL_CUSTOM_UART
	tristate "Custom UART Controller Driver"
	depends on HAS_IOMEM
	select SERIAL_CORE
	help
	  This driver supports the Custom UART controller.
	  It provides full UART functionality including interrupt-driven
	  TX/RX, hardware flow control, and optional DMA support.

	  To compile this driver as a module, choose M here: the
	  module will be called custom_uart.

	  If unsure, say N.

if SERIAL_CUSTOM_UART

config SERIAL_CUSTOM_UART_CONSOLE
	bool "Console on Custom UART"
	depends on SERIAL_CUSTOM_UART=y
	select SERIAL_CORE_CONSOLE
	help
	  If you say Y here, it will be possible to use the Custom UART
	  as the system console (the system console is the device which
	  receives all kernel messages and warnings and which allows
	  logins in single user mode).

	  Even if you say Y here, the currently visible virtual console
	  (/dev/tty0) will still be used as the system console by default,
	  but you can alter that using a kernel command line option such
	  as "console=ttyCustom0".

config SERIAL_CUSTOM_UART_DMA
	bool "DMA support for Custom UART"
	depends on SERIAL_CUSTOM_UART
	depends on DMADEVICES
	select DMA_ENGINE
	help
	  Say Y here if you want to use DMA for data transfers on the
	  Custom UART. This can significantly improve performance for
	  high-speed data transfers by offloading data movement to the
	  DMA controller.

	  If unsure, say N.

config SERIAL_CUSTOM_UART_DMA_BUFFER_SIZE
	int "DMA buffer size (bytes)"
	depends on SERIAL_CUSTOM_UART_DMA
	default 4096
	range 256 65536
	help
	  Set the size of DMA buffers for TX and RX.
	  Larger buffers can improve throughput but use more memory.
	  Default is 4096 bytes.

config SERIAL_CUSTOM_UART_NR_UARTS
	int "Maximum number of Custom UARTs"
	depends on SERIAL_CUSTOM_UART
	default 4
	range 1 16
	help
	  Set the maximum number of Custom UART ports supported.
	  This determines the size of the port array and the number
	  of /dev/ttyCustomN devices that can be created.

config SERIAL_CUSTOM_UART_RS485
	bool "RS-485 support"
	depends on SERIAL_CUSTOM_UART
	help
	  Say Y here if you want RS-485 serial line support.
	  This enables RTS control for RS-485 transceivers.

	  If unsure, say N.

endif # SERIAL_CUSTOM_UART
```

## drivers/sensors/mpu6050/Kconfig
```kconfig
# SPDX-License-Identifier: GPL-2.0-only
#
# Kconfig for MPU6050 6-Axis IMU Driver
#

config MPU6050
	tristate "InvenSense MPU6050 6-Axis Accelerometer/Gyroscope"
	depends on I2C
	select IIO
	select IIO_BUFFER
	select IIO_TRIGGERED_BUFFER
	select REGMAP_I2C
	help
	  Say Y here if you want to support the InvenSense MPU6050,
	  MPU6500, or MPU9250 6-axis accelerometer/gyroscope sensors.

	  This driver provides access to the sensor data through the
	  Industrial I/O (IIO) subsystem.

	  To compile this driver as a module, choose M here: the
	  module will be called mpu6050.

if MPU6050

config MPU6050_I2C
	tristate "MPU6050 I2C support"
	depends on MPU6050
	depends on I2C
	select REGMAP_I2C
	default y if MPU6050
	help
	  Say Y here to enable I2C support for the MPU6050.
	  This is the most common interface for the MPU6050.

config MPU6050_SPI
	tristate "MPU6050 SPI support"
	depends on MPU6050
	depends on SPI_MASTER
	select REGMAP_SPI
	help
	  Say Y here to enable SPI support for the MPU6050/6500/9250.
	  Note: The original MPU6050 only supports I2C, but MPU6500
	  and MPU9250 support both I2C and SPI.

config MPU6050_IRQ
	bool "Interrupt support for MPU6050"
	depends on MPU6050
	default y
	help
	  Say Y here to enable interrupt support for the MPU6050.
	  This allows using the Data Ready interrupt for efficient
	  triggered buffer data capture.

	  When enabled, the driver will request an IRQ if specified
	  in the device tree and set up a hardware trigger.

	  If unsure, say Y.

config MPU6050_TRIGGER
	bool "Hardware trigger support"
	depends on MPU6050
	depends on MPU6050_IRQ
	select IIO_TRIGGER
	default y
	help
	  Say Y here to enable hardware trigger support using the
	  MPU6050's Data Ready interrupt. This creates an IIO trigger
	  that can be used for synchronized sampling.

	  If unsure, say Y.

config MPU6050_DMA
	bool "DMA support for MPU6050 buffer reads"
	depends on MPU6050
	depends on DMADEVICES
	depends on I2C_DMA_SAFE_BUFFER || SPI_MASTER
	help
	  Say Y here to enable DMA for reading sensor data buffers.
	  This can improve performance when reading large amounts of
	  buffered data by using DMA-safe buffers.

	  Note: This requires that the I2C or SPI controller supports
	  DMA transfers.

	  If unsure, say N.

config MPU6050_DMA_BUFFER_SIZE
	int "DMA buffer size (samples)"
	depends on MPU6050_DMA
	default 64
	range 16 1024
	help
	  Set the number of samples to buffer for DMA transfers.
	  Each sample is 14 bytes (3 accel + 1 temp + 3 gyro × 2 bytes).

	  Larger buffers reduce CPU overhead but increase latency.

config MPU6050_FIFO
	bool "Use MPU6050 internal FIFO"
	depends on MPU6050
	help
	  Say Y here to use the MPU6050's internal FIFO for data
	  buffering. The FIFO can hold up to 1024 bytes of sensor data.

	  Using the FIFO can reduce I2C bus traffic and allow burst
	  reads of multiple samples.

	  If unsure, say N.

config MPU6050_DMP
	bool "Digital Motion Processor (DMP) support"
	depends on MPU6050
	help
	  Say Y here to enable support for the MPU6050's Digital Motion
	  Processor (DMP). The DMP can perform sensor fusion calculations
	  (quaternions, Euler angles) in hardware.

	  Note: This requires loading firmware to the DMP.

	  If unsure, say N.

config MPU6050_DEBUG
	bool "Enable debug output"
	depends on MPU6050
	help
	  Say Y here to enable verbose debug output for the MPU6050
	  driver. This includes register read/write logging and
	  interrupt handling debug.

	  If unsure, say N.

endif # MPU6050
```

## drivers/sensors/ultrasonic/Kconfig
```kconfig
# SPDX-License-Identifier: GPL-2.0-only
#
# Kconfig for HC-SR04 Ultrasonic Sensor Driver
#

config HC_SR04
	tristate "HC-SR04 Ultrasonic Distance Sensor"
	depends on GPIOLIB
	select IIO
	help
	  Say Y here if you want to support the HC-SR04 ultrasonic
	  distance sensor.

	  This driver uses two GPIO pins (trigger and echo) to measure
	  distance using ultrasonic pulses. The distance is exposed
	  through the IIO subsystem.

	  To compile this driver as a module, choose M here: the
	  module will be called hc_sr04.

	  If unsure, say N.

if HC_SR04

config HC_SR04_HRTIMER
	bool "Use high-resolution timer for measurements"
	depends on HC_SR04
	depends on HIGH_RES_TIMERS
	help
	  Say Y here to use high-resolution timers for more accurate
	  distance measurements. This improves measurement precision
	  but requires CONFIG_HIGH_RES_TIMERS.

	  If unsure, say Y if available.

config HC_SR04_TEMPERATURE_COMPENSATION
	bool "Temperature compensation"
	depends on HC_SR04
	default y
	help
	  Say Y here to enable temperature compensation for distance
	  calculations. The speed of sound varies with temperature,
	  and compensation improves accuracy.

	  You can set the ambient temperature via sysfs or IIO.

config HC_SR04_DEBUG
	bool "Enable debug output"
	depends on HC_SR04
	help
	  Say Y here to enable debug output including timing
	  information for each measurement.

	  If unsure, say N.

endif # HC_SR04
```
